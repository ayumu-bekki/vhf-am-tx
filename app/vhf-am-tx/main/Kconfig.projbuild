## app/vhf-am-tx/main/Kconfig.projbuild
```kconfig
menu "AM Transmitter"

    config AM_TX_BATTERY_INHIBIT
        bool "Inhibit transmission on low battery"
        default y
        help
            Refuse to start transmitting, and stop a transmission in
            progress, when the 1 second battery average falls below the
            inhibit threshold (kBatInhibitV). The LCD also pins "LOW BATT" on
            the top line.

            Disable this for bench testing on USB power or with no battery
            fitted. Leave it enabled for anything that runs from the pack.

    config AM_TX_ARDF_MODE
        bool "Enable the ARDF mode (with the ARDF ID and CW speed modes)"
        default y
        help
            The ARDF mode runs the five minute fox-hunting schedule (always
            A2A). The ARDF ID and the CW speed (WPM) edit modes only
            make sense with it, so they are left out when this is off. The
            callsign editor is always available. The CW speed then stays at
            the last saved value.

    config AM_TX_CW_MODE
        bool "Enable the CW mode"
        default y
        help
            The CW mode is an A1A hand key: the signal is on the air while SW1
            is held. The carrier is keyed (no steady carrier).

    config AM_TX_DEBUG_MODES
        bool "Enable the debug test modes (D:DUTY, D:CARR, D:TONE, D:DOT, D:BRST)"
        default n
        help
            Adds the bench test modes to the end of the SW_MODE cycle.
            They drive the modulator and the carrier directly (fixed duty,
            carrier only, continuous tone, 5s tone burst per minute) and can
            heat the final stage. Leave this off for normal operation.

endmenu
```
